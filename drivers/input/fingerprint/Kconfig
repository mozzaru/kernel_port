## drivers/input/fingerprint/Kconfig
```kconfig
config INPUT_FINGERPRINT
				tristate "Fingerprint driver support"
				help
				  Say Y here to enable goodix fingerprint driver support!
source "drivers/input/fingerprint/fpc/Kconfig"
source "drivers/input/fingerprint/goodix_e7/Kconfig"
if MACH_XIAOMI_MARKW
source "drivers/input/fingerprint/goodix_markw/Kconfig"
source "drivers/input/fingerprint/fpc_markw/Kconfig"
endif
```
