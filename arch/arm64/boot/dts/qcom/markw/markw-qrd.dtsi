/*
 * Copyright (c) 2015-2016, The Linux Foundation. All rights reserved.
 * Copyright (C) 2019 XiaoMi, Inc.
 *
 * This program is free software; you can redistribute it and/or modify
 * it under the terms of the GNU General Public License version 2 and
 * only version 2 as published by the Free Software Foundation.
 *
 * This program is distributed in the hope that it will be useful,
 * but WITHOUT ANY WARRANTY; without even the implied warranty of
 * MERCHANTABILITY or FITNESS FOR A PARTICULAR PURPOSE.  See the
 * GNU General Public License for more details.
 */

/* msm8953-qrd-sku3 */
&mdss_mdp {
	qcom,mdss-pref-prim-intf = "dsi";
};

&mdss_dsi {
	hw-config = "single_dsi";
};

&mdss_dsi0 {
	lab-supply = <&lab_regulator>;
	ibb-supply = <&ibb_regulator>;
	/delete-property/ vdd-supply;
	qcom,dsi-pref-prim-pan = <&dsi_td4310_fhdplus_e7_vid>;
	pinctrl-names = "mdss_default", "mdss_sleep";
	pinctrl-0 = <&mdss_dsi_active &mdss_te_active>;
	pinctrl-1 = <&mdss_dsi_suspend &mdss_te_suspend>;
	qcom,platform-te-gpio = <&tlmm 24 0>;
	qcom,platform-reset-gpio = <&tlmm 61 0>;
};

&mdss_dsi1 {
	status = "disabled";
};

&dsi_nt35521s_ebbg_720_video {
	qcom,panel-supply-entries = <&dsi_panel_pwr_supply>;
};

&dsi_nt35596_1080_vid {
	qcom,panel-supply-entries = <&dsi_panel_pwr_supply>;
};

&dsi_r63350_1080p_video {
	qcom,panel-supply-entries = <&dsi_panel_pwr_supply>;
};

&int_codec {
	status = "ok";
};

&ext_codec {
	status = "disabled";
};

&slim_msm {
	status = "disabled";
};

&dai_slim {
	status = "disabled";
};

&wcd9xxx_intc {
	status = "disabled";
};

&clock_audio {
	status = "disabled";
};

&wcd9335 {
	status = "disabled";
};

&wcd_rst_gpio {
	status = "disabled";
};

&wsa881x_i2c_f {
        status = "disabled";
};

&wsa881x_i2c_45 {
        status = "disabled";
};

&wsa881x_analog_vi_gpio {
        status = "disabled";
};

&wsa881x_analog_clk_gpio {
        status = "disabled";
};

&wsa881x_analog_reset_gpio {
        status = "disabled";
};

&pmi_haptic {
	status = "okay";
	qcom,vmax-mv = <2700>;
	qcom,play-rate-us = <6667>;
	wf_0 {
		qcom,wf-vmax-mv = <2900>;
		qcom,wf-pattern = [7e 3e 3e 3e];
		qcom,wf-play-rate-us = <6667>;
	};
	wf_1 {
		qcom,wf-vmax-mv = <2900>;
		qcom,wf-pattern = [7e 7e 7e 02 02 02 02 02 02];
		qcom,wf-play-rate-us = <7143>;
	};
	wf_2 {
		qcom,wf-vmax-mv = <2900>;
		qcom,wf-pattern = [7e 7e 7e];
		qcom,wf-play-rate-us = <4000>;
	};
	wf_3 {
		qcom,wf-vmax-mv = <2900>;
		qcom,wf-pattern = [7e 7e 7e 7e];
		qcom,wf-play-rate-us = <6667>;
	};
	wf_4 {
		qcom,wf-vmax-mv = <2900>;
		qcom,wf-pattern = [7e 7e 7e];
		qcom,wf-play-rate-us = <5000>;
	};
	wf_5 {
		qcom,wf-vmax-mv = <2900>;
		qcom,wf-pattern = [7e 7e 7e 7e];
		qcom,wf-play-rate-us = <6667>;
	};
};

/* msm8953-qrd */
&soc {
	gpio-leds {
		compatible = "gpio-leds";
		status = "okay";
		pinctrl-names = "default";
		pinctrl-0 = <&gpio_led_off>;

			infred {
			gpios = <&tlmm 45 0>;
			label = "infrared";
			linux,default-trigger = "infra-red";
			default-state = "off";
			retain-state-suspended;
		};
	};

	fpc1020 {
		compatible = "soc:fpc1020";

		interrupt-parent = <&tlmm>;
		interrupts = <48 0x0>;

		fpc,gpio_rst    = <&tlmm 140 0>;
		fpc,gpio_irq    = <&tlmm 48 0>;

		vcc_spi-supply  = <&pm8953_l5>;
		vdd_ana-supply  = <&pm8953_l5>;
		vdd_io-supply   = <&pm8953_l5>;

		fpc,enable-on-boot;
		/delete-property/
		fpc,enable-wakeup;

		fpc,spi-max-frequency = <4800000>;

		/*For SPI Clock Handled by Linux*/
		clock-names = "iface_clk", "core_clk";
		clocks = <&clock_gcc clk_gcc_blsp1_ahb_clk>,
		<&clock_gcc clk_gcc_blsp1_qup1_spi_apps_clk>;

		pinctrl-names = "fpc1020_spi_active",
			"fpc1020_reset_reset",
			"fpc1020_reset_active",
			"fpc1020_irq_active";

		pinctrl-0 = <&fpc_spi_active>;
		pinctrl-1 = <&fpc_reset_reset>;
		pinctrl-2 = <&fpc_reset_active>;
		pinctrl-3 = <&fpc_irq_active>;
	};

	goodix_fp {
		compatible = "goodix,fingerprint";
		spi-max-frequency = <1000000>;
		input-device-name = "gf3208";
		interrupt-parent = <&tlmm>;
		interrupts = <9 0x0>;

		goodix,gpio_reset    = <&tlmm 140 0>;
		goodix,gpio_irq      = <&tlmm 48 0>;

		clock-names = "iface_clk", "core_clk";
		clocks = <&clock_gcc clk_gcc_blsp1_ahb_clk>,
		<&clock_gcc clk_gcc_blsp1_qup1_spi_apps_clk>;

		pinctrl-names = "goodixfp_spi_active",
				"goodixfp_reset_reset",
				"goodixfp_reset_active",
				"goodixfp_irq_active";

		pinctrl-0 = <&goodix_spi_active>;
		pinctrl-1 = <&goodix_reset_reset>;
		pinctrl-2 = <&goodix_reset_active>;
		pinctrl-3 = <&goodix_irq_active>;
    };
	i2c@78b7000 { /* BLSP1 QUP3 */
		status = "okay";
		/delete-node/ synaptics@4b;
	        vituralsar@33{
			compatible = "virtualsar,sar";
			reg = <0x33>;
			interrupt-parent = <&tlmm>;
			interrupts = <130 0x02>;
			vituralsar,irq-gpio = <&tlmm 130 0x2008>;
		};
    i2c_3  {
	status = "okay";
	/delete-node/ synaptics@4b;
	focaltech@38{
		compatible = "focaltech,fts";
		reg = <0x38>;
		interrupt-parent = <&tlmm>;
		interrupts = <65 0x2008>;
		vdd-supply = <&pm8953_l10>;
		vcc-i2c-supply = <&pm8953_l5>;
		/* pins used by touchscreen */
		pinctrl-names = "pmx_ts_active","pmx_ts_suspend","pmx_ts_release";
		pinctrl-0 = <&ts_int_active &ts_reset_active>;
		pinctrl-1 = <&ts_int_suspend &ts_reset_suspend>;
		pinctrl-2 = <&ts_release>;
		focaltech,reset-gpio = <&tlmm 64 0x00>;
		focaltech,irq-gpio = <&tlmm 65 0x2008>;
		focaltech,display-coords = <0 0 1080 1920>;
		focaltech,max-touch-number = <10>;
		focaltech,wakeup-gestures-en;
		focaltech,have-key;
		focaltech,key-number = <3>;
		focaltech,keys = <139 172 158>;
		focaltech,key-y-coord = <2000>;
		focaltech,key-x-coords = <180 540 900>;
	};
	atmel_mxt_ts@4a {
		compatible = "atmel,mxt-ts";
		reg = <0x4a>;
		interrupt-parent = <&tlmm>;
		interrupts = <65 0x2008>;
		vdd-supply = <&pm8953_l10>;
		vcc_i2c-supply = <&pm8953_l5>;
		/* pins used by touchscreen */
		pinctrl-names = "pmx_ts_active","pmx_ts_suspend","pmx_ts_release";
		pinctrl-0 = <&ts_int_active &ts_reset_active>;
		pinctrl-1 = <&ts_int_suspend &ts_reset_suspend>;
		pinctrl-2 = <&ts_release>;
		atmel,reset-gpio = <&tlmm 64 0x0>;
		atmel,irq-gpio = <&tlmm 65 0x2008>;
		atmel,mxt-fw-name = "mxt_308u.fw";
		atmel,config-array-size = <1>;
		atmel,default-config = <0>;
		atmel,irqflags = <0x2008>;
		atmel,vendor-id-byte = /bits/ 8 <0 3>;
		atmel,cfg_1 {
			atmel,family-id = <0xA6>;
			atmel,variant-id = <0x07>;
			atmel,version = <0x10>;
			atmel,build = <0xAB>;
			atmel,rev-id = <0x2>;
			atmel,panel-id = <0x31>;
			atmel,mxt-cfg-name = "mxt_308u_b5_f.raw";
			atmel,vendor-id = /bits/ 8 <0x31 0x31>; /* Biel HW ver 1 */
			atmel,key-codes = <139 172 158>;
			atmel,selfintthr-stylus = <0>;
			atmel,t71-tchthr-pos = <22>;
			atmel,self-chgtime-min = <0>;
			atmel,self-chgtime-max = <0>;
			atmel,mult-intthr-sensitive = <12>;
			atmel,mult-intthr-not-sensitive = <17>;
			atmel,atchthr-sensitive = <6>;
			atmel,mult-tchthr-sensitive = <0>;
			atmel,mult-tchthr-not-sensitive = <0>;
			atmel,wake-up-self-adcx = <16>;
			atmel,support-wakeup-gesture;
			};
	   };		
};
	i2c@78b6000 { /* BLSP1 QUP3 */
		aw2013@45 {
			compatible = "awinic,aw2013_led";
			reg = <0x45>;
			vdd-supply = <&pm8953_l10>;
			vcc-supply = <&pm8953_l5>;

			aw2013,red {
				aw2013,name = "red";
		                aw2013,id = <0>;
		                aw2013,max-brightness = <150>;
		                aw2013,max-current = <1>;
		                aw2013,rise-time-ms = <3>;
		                aw2013,hold-time-ms = <1>;
		                aw2013,fall-time-ms = <3>;
				aw2013,off-time-ms = <3>;
			};
		};

		aw2023@46 {
			compatible = "awinic,aw2023_led";
			reg = <0x46>;
			vcc-supply = <&pm8953_l5>;
			vdd-supply = <&pm8953_l10>;

			aw2023,red {
				aw2023,name = "red";
				aw2023,id = <0>;
				aw2023,imax = <2>;
				aw2023,led-current = <3>;
				aw2023,max-brightness = <255>;
				aw2023,rise-time-ms = <6>;
				aw2023,hold-time-ms = <0>;
				aw2023,fall-time-ms = <6>;
				aw2023,off-time-ms = <4>;
			};
		};
	};
};

&spi_6 {
	status = "ok";
	peel_ir@0 {
		compatible = "peel_ir";
		reg = <0x0>;
		spi-max-frequency = <19200000>;
		vdd-supply = <&pm8953_l8>; //vdd
		peel_ir,reg-id = "vdd";
		peel_ir,lr-gpio = <73>;
		peel_ir,lr-gpio-valid = <0>;
		peel_ir,spi-bpw = <32>;
		peel_ir,spi-clk-speed = <960000>;
		peel_ir,spi-mode = <0>;
		peel_ir,peel-field = <2345>;
		status = "ok";
	};
};

&spmi_bus {
	qcom,pmi8950@2 {
		qcom,leds@a100 {
			/delete-property/ status;
			/delete-node/ qcom,led_mpp_2;
		};
	};
	qcom,pm8953@0 {
		qcom,leds@a100 {
			status = "okay";
			compatible = "qcom,leds-qpnp";
			reg = <0xa100 0x100>;
			label = "mpp";
			qcom,led_mpp_2 {
				label = "mpp";
				linux,name = "button-backlight";
				linux,default-trigger = "none";
				qcom,default-state = "off";
				qcom,max-current = <10>;
				qcom,current-setting = <5>;
				qcom,id = <6>;
				qcom,mode = "manual";
				qcom,source-sel = <1>;
				qcom,mode-ctrl = <0x61>;
			};
		};
	};
};

/ {
	qrd_batterydata: qcom,battery-data {
		qcom,batt-id-range-pct = <5>;
	#include "panels/dsi-panel-nt35521s-ebbg-720p-video.dtsi"
    #include "panels/dsi-panel-nt35596-ebbg-1080p-video.dtsi"
    #include "panels/dsi-panel-r63350-tianma-1080p-video.dtsi"
		/delete-node/ qcom,qrd_msm8937_sku1_2920mah;
	};
};

&qpnp_smbcharger {
	qcom,battery-data = <&qrd_batterydata>;
	/delete-property/ qcom,chg-led-sw-controls;
	/delete-property/ qcom,chg-led-support;
	/delete-property/ qcom,external-typec;
	/delete-property/ qcom,typec-psy-name;
	qcom,thermal-mitigation = <2500 2000 1500 1000 600 300 0>;
	status = "okay";
};

&qpnp_fg {
	qcom,battery-data = <&qrd_batterydata>;
	qcom,thermal-coefficients = [c8 86 c1 50 d3 37];
	qcom,cold-bat-decidegc = <0>;
	qcom,cool-bat-decidegc = <150>;
	qcom,warm-bat-decidegc = <450>;
	qcom,hot-bat-decidegc = <550>;
	qcom,bad-battery-detection-enable;
};

&sdhc_2 {
	cd-gpios = <&tlmm 133 0x0>;
};

&led_flash0{
	 qcom,flash-source = <&pmi8950_flash0 &pmi8950_flash1>;
	 qcom,torch-source = <&pmi8950_torch0 &pmi8950_torch1>;
};
